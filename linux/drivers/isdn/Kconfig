## linux/drivers/isdn/Kconfig
```kconfig
#
# ISDN device configuration.
#

menu "ISDN subsystem"

config ISDN
	tristate "ISDN support"
	depends on NET
	help
	  ISDN ("Integrated Services Digital Networks", called RNIS in France)
	  is a special type of fully digital telephone service; it's mostly
	  used to connect to your Internet service provider (with SLIP or
	  PPP).	 The main advantage is that the speed is higher than ordinary
	  modem/telephone connections, and that you can have voice
	  conversations while downloading stuff.  It only works if your
	  computer is equipped with an ISDN card and both you and your service
	  provider purchased an ISDN line from the phone company.  For
	  details, read <http://www.alumni.caltech.edu/~dank/isdn/> on the WWW.
	  
	  Select this option if you want your kernel to support ISDN.

comment "CAPI subsystem"
	depends on ISDN

config ISDN_CAPI
	tristate "CAPI2.0 support (EXPERIMENTAL)"
	depends on ISDN && EXPERIMENTAL
	help
	  This provides the CAPI (Common ISDN Application Programming
	  Interface), a standard making it easy for programs to access ISDN
	  hardware, see <http://www.capi.org/>.

source "drivers/isdn/capi/Kconfig"

endmenu
```

## linux/drivers/isdn/capi/Kconfig
```kconfig
#
# Kconfig for the CAPI subsystem.
#

config ISDN_CAPI_MAX_DEVS
	int "Maximum number of ISDN devices"
	range 1 255
	default "4"
	depends on ISDN_CAPI
	help
	  This allows you to specify the maximum number of ISDN devices which
	  the CAPI subsystem will support.

config ISDN_CAPI_MAX_APPLS
	int "Maximum number of CAPI applications"
	range 8 65535
	default "64"
	depends on ISDN_CAPI
	help
	  This allows you to specify the maximum number of CAPI applications
	  which the CAPI subsystem will support.

config ISDN_CAPI_KERNELCAPI
	tristate "CAPI2.0 kernelcapi interface (EXPERIMENTAL)"
	depends on ISDN_CAPI && EXPERIMENTAL
	help
	  This provides the CAPI interface for kernel level applications as
	  described by the CAPI 2.0 standard, see <http://www.capi.org>.
	  However, kernel level applications are encouraged to use the new API,
	  see include/linux/isdn/capiappl.h.

config ISDN_CAPI_CAPI20
	tristate "CAPI2.0 /dev/capi20 support (EXPERIMENTAL)"
	depends on ISDN_CAPI && EXPERIMENTAL
	help
	  This option will provide the CAPI 2.0 interface to userspace
	  applications via /dev/capi20.	 Applications should use the
	  standardized libcapi20 to access this functionality.	You should say
	  Y/M here.

config ISDN_CAPI_MIDDLEWARE
	bool "CAPI2.0 Middleware support"
	depends on ISDN_CAPI_CAPI20
	help
	  This option will enhance the capabilities of the /dev/capi20
	  interface.  It will provide a means of moving a data connection,
	  established via the usual /dev/capi20 interface to a special tty
	  device.  If you want to use pppd with pppdcapiplugin to dial up to
	  your ISP, say Y here.

config ISDN_CAPI_CAPIFS_BOOL
	bool "CAPI2.0 filesystem support"
	depends on ISDN_CAPI_MIDDLEWARE
	help
	  This option provides a special file system, similar to /dev/pts with
	  device nodes for the special ttys established by using the
	  middleware extension above.  If you want to use pppd with
	  pppdcapiplugin to dial up to your ISP, say Y here.

config ISDN_CAPI_CAPIFS
	tristate
	depends on ISDN_CAPI_CAPIFS_BOOL
	default ISDN_CAPI_CAPI20

config ISDN_CAPI_CAPIDRV
	tristate "CAPI2.0 capidrv interface support (EXPERIMENTAL)"
	depends on ISDN_CAPI && ISDN_I4L && EXPERIMENTAL
	help
	  This option provides the glue code to hook up CAPI driven cards to
	  the legacy isdn4linux link layer.  If you have a card which is
	  supported by a CAPI driver, but still want to use old features like
	  ippp interfaces or ttyI emulation, say Y/M here.
```
